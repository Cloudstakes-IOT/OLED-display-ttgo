/************************************************************************************
   Created By: Ritesh Soni
   Created On: April-2022
 * ****************************************************************************
   For Cloudstakes
   https://cloudstakes.com/
 * ****************************************************************************
    DHT
    GSM
    OLED
    Battery
 **********************************************************************************/

#include <Wire.h>
#include "DHT.h"
#include <GyverOLED.h>
#define DHTPIN 13

#define DHTTYPE DHT11

#define OLED_SDA 32
#define OLED_SCL 33

const uint8_t bitmap_66x60[] PROGMEM = {
  0x00, 0x00, 0x00, 0x00, 0x00, 0x00, 0x00, 0x00, 0x00, 0x00, 0x00, 0x00,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 0x00,
  0x00, 0x00, 0x00, 0x00, 0x00, 0x00, 0xC0, 0xE0, 0xE0, 0x70, 0x30, 0x38,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 0x00,
  0x00, 0x00, 0x00, 0x00, 0x00, 0x00, 0xFF, 0xFF, 0x00, 0x00, 0x00, 0x00,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 0x00,
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  0x00, 0x00, 0x00, 0x00, 0x00, 0x00, 0x00, 0x00, 0x00, 0x00, 0x00, 0x00,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 0x00,
};

const static uint8_t icons_8x8[][8] PROGMEM = {
  {0x00, 0xe0, 0x00, 0xf0, 0x00, 0xfc, 0x00, 0xff}, //51 mobile network 100%
  {0x00, 0xe0, 0x00, 0xf0, 0x00, 0xfc, 0x00, 0x80}, //52 mobile network 75%
  {0x00, 0xe0, 0x00, 0xf0, 0x00, 0x80, 0x00, 0x80}, //53 mobile network 50%
  {0x00, 0xe0, 0x00, 0x80, 0x00, 0x80, 0x00, 0x80}, //54 mobile network 25%
};

GyverOLED<SSH1106_128x64> oled;
DHT dht(DHTPIN, DHTTYPE);

#define SIM800L_RX     27
#define SIM800L_TX     26
#define SIM800L_PWRKEY 4
#define SIM800L_RST    5
#define SIM800L_POWER  23

#define batt 35

#include <Pangodream_18650_CL.h>
Pangodream_18650_CL BL;

String apn = "www";                    //APN
String apn_u = "";                     //APN-Username
String apn_p = "";                     //APN-Password
String url = "http://www.infernoinfosec.in/test.php";  //URL of Server
String apiKeyValue = "tPmAT5Ab3j7F9";


void setup() {
  Serial.begin(9600);
  Serial.println(F("DHTxx test!"));
  pinMode(batt, INPUT);
  dht.begin();
  Wire.begin(OLED_SDA, OLED_SCL);
  oled.init();

  oled.clear();
  oled.drawBitmap(35, 0, bitmap_66x60, 66, 60);
  oled.update();


  pinMode(SIM800L_POWER, OUTPUT);
  digitalWrite(SIM800L_POWER, HIGH);
  Serial.begin(115200);
  Serial.println("ESP32+SIM800L AT CMD Test");
  Serial2.begin(9600, SERIAL_8N1, SIM800L_TX, SIM800L_RX);
  delay(15000);
  while (Serial2.available()) {
    Serial.write(Serial2.read());
  }
  gsm_config_gprs();
}

void loop() {
  delay(1000);

  float h = dht.readHumidity();
  float t = dht.readTemperature();
  float f = dht.readTemperature(true);

  if (isnan(h) || isnan(t) || isnan(f)) {
    Serial.println(F("Failed to read from DHT sensor!"));
    return;
  }

  float hif = dht.computeHeatIndex(f, h);
  float hic = dht.computeHeatIndex(t, h, false);

  Serial.print(F("Humidity: "));
  Serial.print(h);
  Serial.print(F("%  Temperature: "));
  Serial.print(t);

  oled.clear();
  oled.update();

  Serial.println(analogRead(batt));
  float raw = 0;
  for (int i = 0; i < 10; i++)
  {
    raw += analogRead(batt);
  }
  raw = raw / 10;
  raw = (raw * 1.73) / 1000;

  Serial.print("Battery Voltage - ");
  Serial.println(raw);

  if (raw >= 3.8)
  {
    oled.clear();
    oled.setCursorXY(110, 0);
    drawBattery(100);
    oled.update();
  }
  if (3.8 > raw && raw >= 3.6)
  {
    oled.clear();
    oled.setCursorXY(0, 0);
    drawBattery(50);
    oled.update();
  }
  if (3.6 > raw && raw >= 3.4)
  {
    oled.clear();
    oled.setCursorXY(0, 0);
    drawBattery(20);
    oled.update();
  }
  if ( raw < 3.4)
  {
    oled.clear();
    oled.setCursorXY(0, 0);
    drawBattery(0);
    oled.update();
  }


  oled.setCursorXY(0, 0);
  drawIcon8x8(0);

  signal_strength();

  oled.setCursor(0, 3);
  oled.print("Humidity: ");
  oled.print(h);

  // --------------------------
  oled.setCursor(0, 4);
  oled.print("Temperature: ");
  oled.print(t);
  //-----------------------------
  oled.setCursor(44, 7);
  oled.print("By CloudStakes");
  oled.update();
  //-----------------------------
  //  scrollText();
  gsm_http_post("api_key=" + apiKeyValue + "&value1=" + String(t) + "&value2=" + String(h) + "&value3=" + String("100%") + "&value4=" + String("100%") + "&value5=" + String("01") + "&value6=" + String("0123456789") + "&value7=" + String("0123456789") + "&value8=" + String("Direct") + "&value9=" + String("ACTIVE") + "&value10=" + String("19:06") + "");
  delay(30000);
}
void gsm_http_post( String postdata) {
  Serial.println(" --- Start GPRS & HTTP --- ");
  gsm_send_serial("AT+SAPBR=1,1");
  gsm_send_serial("AT+SAPBR=2,1");
  gsm_send_serial("AT+HTTPINIT");
  gsm_send_serial("AT+HTTPPARA=CID,1");
  gsm_send_serial("AT+HTTPPARA=URL," + url);
  gsm_send_serial("AT+HTTPPARA=CONTENT,application/x-www-form-urlencoded");
  gsm_send_serial("AT+HTTPDATA=192,5000");
  gsm_send_serial(postdata);
  gsm_send_serial("AT+HTTPACTION=1");
  gsm_send_serial("AT+HTTPREAD");
  gsm_send_serial("AT+HTTPTERM");
  gsm_send_serial("AT+SAPBR=0,1");
}

void gsm_config_gprs() {
  Serial.println(" --- CONFIG GPRS --- "); 
  gsm_send_serial("AT+SAPBR=3,1,Contype,GPRS");
  gsm_send_serial("AT+SAPBR=3,1,APN," + apn);
  if (apn_u != "") {
    gsm_send_serial("AT+SAPBR=3,1,USER," + apn_u);
  }
  if (apn_p != "") {
    gsm_send_serial("AT+SAPBR=3,1,PWD," + apn_p);
  }
}

void gsm_send_serial(String command) {
  Serial.println("Send ->: " + command);
  Serial2.println(command);
  long wtimer = millis();
  while (wtimer + 3000 > millis()) {
    while (Serial2.available()) {
      Serial.write(Serial2.read());
    }
  }
  Serial.println();
}
void drawBattery(byte percent) {
  oled.drawByte(0b00111100);  // пипка
  oled.drawByte(0b00111100);
  oled.drawByte(0b11111111);  // стенка
  for (byte i = 0; i < 100 / 8; i++) {
    if (i < (100 - percent) / 8) oled.drawByte(0b10000001);
    else oled.drawByte(0b11111111);
  }
  oled.drawByte(0b11111111);  // попка
}
void drawIcon8x8(byte index) {
  size_t s = sizeof icons_8x8[index];//можна так, а можна просто 8
  for (unsigned int i = 0; i < s; i++) {
    oled.drawByte(pgm_read_byte(&(icons_8x8[index][i])));
  }
}
void signal_strength() {
  char mydata[18];
  gsm_send_serial("AT+CSQ");
  
}
